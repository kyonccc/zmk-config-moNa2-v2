## config/west.yml
```yaml
manifest:
  remotes:
    - name: zmkfirmware
      url-base: https://github.com/zmkfirmware
    - name: badjeff    # <-- PMW3610のドライバとオーバーレイの整合性を維持
      url-base: https://github.com/badjeff
    - name: caksoylar  # <-- 既存のLEDインジケータ通知との同期
      url-base: https://github.com/caksoylar
    - name: zettaface  # <-- キーバインドプロセッサの維持
      url-base: https://github.com/zettaface
  projects:
    - name: zmk
      remote: zmkfirmware
      revision: v0.3
      import: app/west.yml
    - name: zmk-pmw3610-driver
      remote: badjeff
      revision: zmk-0.3
    - name: zmk-rgbled-widget
      remote: caksoylar
      revision: v0.3-branch
    - name: zmk-input-processor-keybind
      remote: zettaface
      revision: main
  self:
    path: config
```
